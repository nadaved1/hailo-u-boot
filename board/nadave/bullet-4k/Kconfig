## board/nadave/bullet-4k/Kconfig
```kconfig
if TARGET_BULLET_4K
  config SYS_BOARD
    default "bullet-4k"
  config SYS_VENDOR
    default "nadave"
  config SYS_CONFIG_NAME
    default "bullet-4k"
endif
```

## board/nadave/bullet_4k/Kconfig
```kconfig
if TARGET_BULLET_4K
  config SYS_BOARD
    default "bullet_4k"
  config SYS_VENDOR
    default "nadave"
  config SYS_CONFIG_NAME
    default "bullet_4k"
endif
```

## configs/bullet-4k_defconfig
```kconfig
CONFIG_ARM=y
CONFIG_ARCH_HAILO=y
CONFIG_TARGET_BULLET_4K=y
CONFIG_DEFAULT_DEVICE_TREE="bullet-4k"
```
